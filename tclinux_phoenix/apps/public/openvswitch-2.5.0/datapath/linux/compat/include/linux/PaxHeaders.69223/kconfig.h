## tclinux_phoenix/linux-2.6.36/drivers/usb/host/mtk_test/Kconfig
```kconfig
#
# USB Host Controller Drivers
#
comment "USB Host Controller Drivers"
	depends on USB

config USB_MTK_XHCI_HCD_TEST_DRV
	tristate "MTK xHCI HCD (USB 3.0) Test Driver"
	depends on USB 

config USB_XHCI_HCD_DEBUGGING
	bool "Debugging for the xHCI host controller"
	depends on USB_MTK_XHCI_HCD_TEST_DRV
	---help---
	  Say 'Y' to turn on debugging for the xHCI host controller driver.
	  This will spew debugging output, even in interrupt context.
	  This should only be used for debugging xHCI driver bugs.

	  If unsure, say N.

config U3_PHY_GPIO_SUPPORT
	depends on USB_MTK_XHCI_HCD_TEST_DRV
	bool "U3 PHY GPIO access registers support"

config A60810_SUPPORT
	depends on USB_MTK_XHCI_HCD_TEST_DRV
        bool "U3 PHY A60810 support"
```

## tclinux_phoenix/modules/public/usb_camera/v4l/Kconfig.kern
```kconfig
# Needed by RADIO_MIROPCM20
config SND_MIRO
	tristate
	default n

# Needed by VIDEO_GO7007, SMS_SIANO_MDTV, USB_PWC_INPUT_EVDEV, DVB_USB, VIDEO_CX18, VIDEO_CX88, VIDEO_CX25821, VIDEO_CX231XX, IR_CORE, VIDEO_CX23885, VIDEO_EM28XX, DVB_DM1105, VIDEO_BT848, VIDEO_TLG2300, VIDEO_SAA7134, DVB_BUDGET_CI, MANTIS_CORE, VIDEO_IVTV, VIDEO_AU0828, DVB_TTUSB_DEC, VIDEO_TM6000, USB_VIDEO_CLASS_INPUT_EVDEV
config INPUT
	tristate
	default n

# Needed by USB_DSBR, USB_ZR364XX, DVB_USB, VIDEO_PVRUSB2_DVB, VIDEO_CPIA_USB, USB_GSPCA_OV534, USB_STKWEBCAM, USB_PWC, USB_DABUSB, VIDEO_EM28XX, USB_GSPCA_SN9C2028, USB_VICAM, USB_GL860, VIDEO_USBVISION, VIDEO_CX231XX_ALSA, USB_GSPCA_T613, VIDEO_GO7007_USB, USB_GSPCA_STK014, USB_GSPCA_SPCA506, USB_ZC0301, USB_SI470X, USB_GSPCA_PAC207, DVB_TTUSB_DEC, USB_GSPCA_OV534_9, USB_GSPCA_SN9C20X, SMS_USB_DRV, USB_GSPCA_SPCA561, USB_STV06XX, USB_GSPCA_SPCA501, USB_GSPCA_ETOMS, USB_GSPCA_SPCA508, USB_GSPCA_SPCA505, USB_GSPCA_STV0680, VIDEO_CX231XX, USB_GSPCA_PAC7311, USB_GSPCA_FINEPIX, USB_GSPCA_CPIA1, USB_GSPCA_SQ905C, VIDEO_CX231XX_DVB, IR_IMON, USB_GSPCA, USB_MR800, USB_GSPCA_VC032X, VIDEO_EM28XX_ALSA, USB_M5602, VIDEO_USBVIDEO, VIDEO_PVRUSB2_DEBUGIFC, USB_VIDEO_CLASS, USB_GSPCA_SONIXJ, USB_GSPCA_MR97310A, USB_QUICKCAM_MESSENGER, VIDEO_TLG2300, USB_GSPCA_TV8532, DVB_B2C2_FLEXCOP_USB, USB_GSPCA_SQ905, USB_IBMCAM, VIDEO_PVRUSB2_SYSFS, VIDEO_OVCAMCHIP, USB_GSPCA_SUNPLUS, DVB_TTUSB_BUDGET, USB_W9968CF, USB_PWC_INPUT_EVDEV, USB_SN9C102, VIDEO_EM28XX_DVB, USB_GSPCA_MARS, USB_GSPCA_CONEX, USB_GSPCA_BENQ, USB_ET61X251, VIDEO_CPIA2, VIDEO_HDPVR, USB_S2255, USB_KONICAWC, USB_SE401, USB_GSPCA_PAC7302, USB_GSPCA_OV519, VIDEO_PVRUSB2, USB_GSPCA_JEILINJ, USB_PWC_DEBUG, USB_GSPCA_SPCA500, VIDEO_AU0828, VIDEO_TM6000, USB_OV511, USB_STV680, USB_GSPCA_SONIXB, USB_VIDEO_CLASS_INPUT_EVDEV, V4L_USB_DRIVERS, USB_GSPCA_ZC3XX
config USB
	tristate
	default m

# Needed by VIDEO_ISIF
config ARCH_DAVINCI_DM365
	tristate
	default n

# Needed by VIDEO_SAA7164
config FW_LOADER
	tristate
	default n

# Needed by VIDEO_VIVI
config SPARC64
	tristate
	default n

# Needed by VIDEO_M32R_AR_M64278
config PLAT_M32700UT
	tristate
	default n

# Needed by SND_FM801_TEA575X
config SND_FM801
	tristate
	default n

# Needed by VIDEO_FB_IVTV
config FB_CFB_IMAGEBLIT
	tristate
	default n

# Needed by SOC_CAMERA_MT9M001, SOC_CAMERA_MT9V022
config GPIO_PCA953X
	tristate
	default n

# Needed by VIDEO_SH_MOBILE_CEU
config HAVE_CLK
	tristate
	default n

# Needed by VIDEO_MX1
config FIQ
	tristate
	default n

# Needed by VIDEO_OMAP2_VOUT
config OMAP2_DSS
	tristate
	default n

# Needed by VIDEO_GO7007, VIDEO_CX231XX_ALSA, VIDEO_SAA7134_ALSA, VIDEO_TM6000_ALSA, VIDEO_TLG2300, VIDEO_CX88_ALSA, RADIO_MIROPCM20, VIDEO_EM28XX_ALSA, SND_BT87X, VIDEO_CX18_ALSA, VIDEO_CX25821_ALSA
config SND
	tristate
	default n

# Needed by SOC_CAMERA_MT9M001
config MT9M001_PCA9536_SWITCH
	tristate
	default n

# Needed by VIDEO_OMAP2
config ARCH_OMAP2
	tristate
	default n

# Needed by VIDEO_VIVI
config FONT_8x16
	tristate
	default n

# Needed by VIDEO_VIVI
config SPARC32
	tristate
	default n

# Needed by VIDEO_BT848, DVB_PLUTO2, VIDEO_ZORAN, VIDEO_CX18, VIDEO_CX88, VIDEO_IVTV, VIDEO_AU0828, VIDEO_CX25821, VIDEO_CX23885, VIDEO_SAA7164
config I2C_ALGOBIT
	tristate
	default n

# Needed by RADIO_MIROPCM20
config SND_ISA
	tristate
	default n

# Needed by DVB_CORE
config INET
	tristate
	default y

# Needed by VIDEO_GO7007, DVB_CORE, DVB_TTUSB_DEC, VIDEO_SAA7134
config CRC32
	tristate
	default y

# Needed by VIDEO_PVRUSB2_SYSFS
config SYSFS
	tristate
	default n

# Needed by SMS_SDIO_DRV
config MMC
	tristate
	default n

# Needed by RADIO_RTRACK2, RADIO_AZTECH, RADIO_TERRATEC, RADIO_SF16FMR2, RADIO_RTRACK, RADIO_MIROPCM20, RADIO_CADET, VIDEO_PMS, RADIO_TRUST, RADIO_SF16FMI, RADIO_ZOLTRIX, RADIO_GEMTEK, RADIO_TYPHOON
config ISA
	tristate
	default n

# Needed by VIDEO_OMAP2_VOUT
config OMAP2_VRFB
	tristate
	default n

# Needed by VIDEO_GO7007, SND_BT87X, VIDEO_CX25821, DVB_PT1, VIDEO_CX23885, DVB_DM1105, VIDEO_HEXIUM_ORION, VIDEO_MEYE, DVB_NGENE, DVB_MANTIS, DVB_BUDGET_CORE, DVB_PLUTO2, VIDEO_HEXIUM_GEMINI, VIDEO_STRADIS, MANTIS_CORE, RADIO_GEMTEK_PCI, VIDEO_IVTV, DVB_HOPPER, DVB_TTUSB_DEC, RADIO_MAXIRADIO, DVB_TTUSB_BUDGET, DVB_AV7110, DVB_BT8XX, VIDEO_CX18, VIDEO_MXB, VIDEO_CX88, VIDEO_SAA7146, RADIO_MAESTRO, VIDEO_BTCX, VIDEO_SAA7164, DVB_B2C2_FLEXCOP_PCI, VIDEO_BT848, VIDEO_SAA7134, VIDEO_CAFE_CCIC, VIDEO_ZORAN
config PCI
	tristate
	default y

# Needed by VIDEO_OMAP2_VOUT
config OMAP2_VRAM
	tristate
	default n

# Needed by VIDEO_W9966, VIDEO_CPIA_PP
config PARPORT_1284
	tristate
	default n

# Needed by VIDEO_FB_IVTV
config FB_CFB_FILLRECT
	tristate
	default n

# Needed by SOC_CAMERA_MT9V022
config MT9V022_PCA9536_SWITCH
	tristate
	default n

# Needed by VIDEO_ZORAN, VIDEO_STRADIS
config VIRT_TO_BUS
	tristate
	default y

# Needed by VIDEO_W9966, VIDEO_BWQCAM, VIDEO_CPIA_PP, VIDEO_CQCAM
config PARPORT
	tristate
	default n

# Needed by VIDEO_DM6446_CCDC
config ARCH_DAVINCI_DM644x
	tristate
	default n

# Needed by DVB_FIREDTV
config FIREWIRE
	tristate
	default n

# Needed by DVB_CORE
config NET
	tristate
	default y

# Needed by VIDEO_VPFE_CAPTURE, VIDEO_VPSS_SYSTEM
config ARCH_DAVINCI
	tristate
	default n

# Needed by VIDEO_FB_IVTV
config FB_CFB_COPYAREA
	tristate
	default n

# Needed by VIDEO_PXA27x
config PXA27x
	tristate
	default n

# Needed by VIDEO_VINO
config SGI_IP22
	tristate
	default n

# Needed by VIDEO_OMAP2_VOUT
config ARCH_OMAP34XX
	tristate
	default n

# Needed by VIDEO_GO7007, DVB_AF9013, VIDEO_SAA711X, MEDIA_TUNER_TDA18271, DVB_MT312, DVB_CX24116, DVB_USB, VIDEO_EM28XX, DVB_S5H1420, DVB_CX22700, SOC_CAMERA, VIDEO_USBVISION, VIDEO_BT866, VIDEO_V4L2_COMMON, DVB_NGENE, DVB_SP8870, DVB_BUDGET_AV, MEDIA_TUNER, DVB_TUNER_DIB0070, VIDEO_VPX3220, MEDIA_TUNER_TDA827X, DVB_OR51132, VIDEO_TDA9875, SOC_CAMERA_RJ54N1, VIDEO_SAA7110, DVB_LGDT3305, DVB_STV6110x, DVB_BT8XX, VIDEO_SAA7127, MEDIA_TUNER_MT2060, VIDEO_CX231XX, VIDEO_UPD64083, VIDEO_WM8739, VIDEO_SAA7164, DVB_AU8522, DVB_CX22702, DVB_ISL6423, DVB_B2C2_FLEXCOP_PCI, VIDEO_BT848, I2C_SI4713, DVB_BUDGET_PATCH, VIDEO_CS53L32A, SOC_CAMERA_MT9V022, SOC_CAMERA_MT9T031, DVB_ISL6405, VIDEO_ADV7343, DVB_ZL10353, DVB_CX24110, MEDIA_TUNER_XC2028, DVB_DIB7000M, VIDEO_BT856, VIDEO_ADV7175, DVB_DIB3000MC, DVB_PT1, MEDIA_TUNER_MC44S803, DVB_DRX397XD, DVB_TDA8261, DVB_MANTIS, DVB_BUDGET_CORE, DVB_TDA8083, VIDEO_VP27SMPX, VIDEO_CX25840, DVB_B2C2_FLEXCOP_USB, VIDEO_IVTV, DVB_HOPPER, VIDEO_TVP5150, VIDEO_SAA5246A, MEDIA_TUNER_SIMPLE, RADIO_SI4713, VIDEO_TEA6415C, DVB_TUNER_CX24113, DVB_OR51211, VIDEO_OVCAMCHIP, DVB_STB6100, DVB_AV7110, SOC_CAMERA_MT9M111, VIDEO_OV7670, DVB_STV0299, SOC_CAMERA_OV772X, VIDEO_CX88, MEDIA_TUNER_QT1010, DVB_S5H1411, VIDEO_TCM825X, DVB_PLL, DVB_LGDT330X, VIDEO_PVRUSB2, DVB_MB86A16, VIDEO_SAA7134, DVB_STB0899, VIDEO_TVP514X, DVB_TUA6100, VIDEO_CAFE_CCIC, VIDEO_MT9V011, DVB_LNBP21, DVB_B2C2_FLEXCOP, TTPCI_EEPROM, VIDEO_TM6000, VIDEO_THS7303, DVB_NXT200X, MEDIA_TUNER_TDA8290, VIDEO_SAA7185, VIDEO_TEA6420, DVB_STV0297, VIDEO_KS0127, VIDEO_TVP7002, DVB_VES1820, VIDEO_SAA717X, RADIO_TEA5764, MEDIA_TUNER_MT20XX, VIDEO_CX23885, DVB_BUDGET, DVB_VES1X93, DVB_DM1105, VIDEO_CS5345, VIDEO_TVEEPROM, DVB_ATBM8830, VIDEO_HEXIUM_GEMINI, DVB_ISL6421, I2C_SI470X, DVB_TDA10021, MEDIA_TUNER_TDA9887, DVB_NXT6000, VIDEO_SAA7191, RADIO_TIMBERDALE, MEDIA_TUNER_XC5000, SOC_CAMERA_MT9T112, DVB_TDA10048, MEDIA_TUNER_MXL5005S, MEDIA_TUNER_TEA5761, VIDEO_TDA7432, VIDEO_BT819, DVB_EC100, MEDIA_TUNER_MT2266, VIDEO_ADV7180, VIDEO_CX18, DVB_TDA1004X, VIDEO_MXB, VIDEO_SAA7146, DVB_TUNER_ITD1000, DVB_STV6110, VIDEO_ADV7170, DVB_S921, VIDEO_TDA9840, DVB_CX24123, DVB_TDA10023, DVB_S5H1409, DVB_TUNER_DIB0090, VIDEO_IR_I2C, MEDIA_TUNER_MAX2165, MEDIA_TUNER_MT2131, VIDEO_CX25821, DVB_STV0288, VIDEO_HEXIUM_ORION, VIDEO_SAA6588, VIDEO_M52790, SOC_CAMERA_OV9640, DVB_DS3000, VIDEO_UPD64031A, VIDEO_TVAUDIO, MEDIA_TUNER_TEA5767, VIDEO_TLG2300, DVB_L64781, DVB_PLUTO2, DVB_LGDT3304, DVB_STB6000, DVB_TDA665x, RADIO_SAA7706H, DVB_BUDGET_CI, DVB_MT352, MANTIS_CORE, VIDEO_MSP3400, DVB_DIB8000, DVB_TDA826X, SOC_CAMERA_TW9910, DVB_TDA10086, DVB_TTUSB_BUDGET, VIDEO_WM8775, VIDEO_TLV320AIC23B, USB_W9968CF, MEDIA_TUNER_MXL5007T, VIDEO_VINO, DVB_SP887X, DVB_DIB7000P, SOC_CAMERA_MT9M001, VIDEO_AK881X, DVB_DIB3000MB, DVB_LGS8GXX, DVB_LGS8GL5, DVB_SI21XX, DVB_ZL10036, DVB_BCM3510, DVB_STV0900, DVB_ZL10039, VIDEO_SAA5249, RADIO_TEF6862, VIDEO_AU0828, DVB_STV090x
config I2C
	tristate
	default n

# Needed by VIDEO_DM355_CCDC
config ARCH_DAVINCI_DM355
	tristate
	default n

# Needed by MEDIA_ATTACH, always
config MODULES
	tristate
	default y

# Needed by VIDEO_TM6000
config TUNER_XC2028
	tristate
	default n

# Needed by MEDIA_SUPPORT
config HAS_IOMEM
	tristate
	default y

# Needed by DISPLAY_DAVINCI_DM646X_EVM, CAPTURE_DAVINCI_DM646X_EVM
config MACH_DAVINCI_DM6467_EVM
	tristate
	default n

# Needed by RADIO_TIMBERDALE
config MFD_TIMBERDALE
	tristate
	default n

# Needed by VIDEO_OMAP2_VOUT
config ARCH_OMAP24XX
	tristate
	default n

# Needed by VIDEO_SH_MOBILE_CEU, VIDEOBUF_DMA_SG, SMS_SIANO_MDTV, SOC_CAMERA, VIDEOBUF_DMA_CONTIG
config HAS_DMA
	tristate
	default y

# Needed by VIDEO_FB_IVTV
config FB
	tristate
	default n

# Needed by VIDEO_MX1
config ARCH_MX1
	tristate
	default n

# Needed by VIDEO_MEYE
config SONY_LAPTOP
	tristate
	default n

# Needed by IR_IMON
config USB_ARCH_HAS_HCD
	tristate
	default y

# Needed by VIDEO_MX3
config MX3_IPU
	tristate
	default n

# Needed by VIDEO_GO7007, VIDEO_CX231XX_ALSA, VIDEO_SAA7134_ALSA, VIDEO_TM6000_ALSA, VIDEO_TLG2300, VIDEO_CX88_ALSA, VIDEO_EM28XX_ALSA, SND_BT87X, VIDEO_CX18_ALSA, VIDEO_CX25821_ALSA
config SND_PCM
	tristate
	default n

# Needed by VIDEO_VIVI
config FONTS
	tristate
	default n

# Needed by VIDEO_SH_VOU
config ARCH_SHMOBILE
	tristate
	default n

# Needed by VIDEO_TM6000_ALSA, DVB_USB_EC168, VIDEO_TLV320AIC23B, VIDEO_CX88_ALSA, VIDEO_VINO, MEDIA_TUNER_TEA5761, VIDEO_PVRUSB2_DVB, VIDEO_CX18, DVB_USB_AF9005, VIDEO_TM6000_DVB, USB_STKWEBCAM, USB_VICAM, VIDEO_CQCAM, DVB_USB_CE6230, VIDEO_STRADIS, VIDEO_ZORAN_AVS6EYES, VIDEO_PVRUSB2_SYSFS, VIDEO_CX18_ALSA, VIDEO_TM6000, VIDEO_CX25821_ALSA
config EXPERIMENTAL
	tristate
	default y

# Needed by VIDEO_M32R_AR
config M32R
	tristate
	default n

# Needed by DVB_FIREDTV
config IEEE1394
	tristate
	default n
```

## tclinux_phoenix/modules/public/usb_camera/v4l_experimental/v3tv/Kconfig
```kconfig
#
# Voodoo3 3500 TV Video For Linux
#

config VIDEO_V3TV
	tristate "Voodoo3 3500 TV Video For Linux"
	depends on VIDEO_DEV && PCI && I2C_ALGOBIT && SOUND
	--- help ---
	  Support for Voodoo3 3500 TV cards.  Please visit v3tv.sourceforge.net 
	  for details.

	  This option also builds msp3400.o, tuner.o, and vpx3224.o.

          If you say Y or M here, you need to say Y or M to: 

            "Voodoo 3" in the I2C Hardware Bus support section
            "Video 4 Linux TV-Mixer" in the sound device section

          To compile this driver as a module, choose M here: the
          module will be called v3tv.

config V3TV_VERBOSEDEBUG
	bool '    Excessive V3TV debugging output'
	depends on VIDEO_V3TV

endmenu
```
